/*
 * spi_send_data_test.c
 *
 *  Created on: 31-Jul-2026
 *      Author: Viresh
 */


#include <stdint.h>
#include "STM32F401CCUx.h"
#include "stm32f401ccux_gpio_driver.h"
#include "spi.h"


/////////////////////////  CMD CODES  ///////////////////

#define CMD_LED_CTRL             0x50
#define CMD_LED_SENSORREAD       0x51
#define CMD_LED_READ             0x52
#define CMD_PRINT                0x53
#define CMD_ID_READ              0x54

#define LED_PIN                 2
////////  ANALOG PINS     ///////
#define A0     27
#define A1     14
#define A2     12
#define A3     13
// Send "HELLO WORLD"  in Master Mode
	// SPI2 MASTER MODE
	// SCLK Max
	// DFF = 0 and DFF = 1
	//pg num 45
	// PB12 as NSS
	// PB13 as SCLK
	// PB15 as MOSI
	// PB14 as MISO
	// AF05

void SPI2_GPIO_INIT(void)
{
	// GPIO_CLK_ENABLE

	gpio_handle_t SPI_PINS;
	SPI_PINS.pGPIOx = GPIOB;
	SPI_PINS.gpio_config.gpio_PinMode = GPIO_MODE_ALT_FUN;
	SPI_PINS.gpio_config.gpio_Alt_Func_Mode = GPIO_AF5;
	SPI_PINS.gpio_config.gpio_PinOtype = GPIO_OTYPE_PP;
	SPI_PINS.gpio_config.gpio_PinPupdControl = GPIO_NO_PUPD;
	SPI_PINS.gpio_config.gpio_PinSpeed = SPEED_VERY_HIGH;
	// CLK CONFIG
	SPI_PINS.gpio_config.gpio_PinNumber = GPIO_PIN_NO_13;
	GPIO_INIT(&SPI_PINS);

	// MISO CONFIG
		SPI_PINS.gpio_config.gpio_PinNumber = GPIO_PIN_NO_14;
		GPIO_INIT(&SPI_PINS);

	// MOSI CONFIG
	    SPI_PINS.gpio_config.gpio_PinNumber = GPIO_PIN_NO_15;
		GPIO_INIT(&SPI_PINS);

	// NSS CONFIG
		SPI_PINS.gpio_config.gpio_PinNumber = GPIO_PIN_NO_12;
		GPIO_INIT(&SPI_PINS);
}

void SPI2_INIT(void)
{

	SPI_HANDLE_T SPI2_HANDLE;
	SPI2_HANDLE.pSPIx = SPI2;
	SPI2_HANDLE.SPI_CONFIG.SPI_BusConfig = SPI_DEVICE_FD;
	SPI2_HANDLE.SPI_CONFIG.SPI_DeviceMode = SPI_DEVICE_MASTER;
	SPI2_HANDLE.SPI_CONFIG.SPI_SCLKspeed = SPI_SCLK_DIV32;
	SPI2_HANDLE.SPI_CONFIG.SPI_DFF = SPI_DFF_8BIS;
	SPI2_HANDLE.SPI_CONFIG.SPI_CPOL = SPI_CPOL_LOW;
	SPI2_HANDLE.SPI_CONFIG.SPI_CPHA = SPI_CPHA_LOW;
	SPI2_HANDLE.SPI_CONFIG.SPI_SSM= SPI_SSM_DI; // soft slave management enable

	SPI_INIT(&SPI2_HANDLE);
}


void Button_init(){
	gpio_handle_t SWITCH;
	SWITCH.pGPIOx = GPIOA;
		SWITCH.gpio_config.gpio_PinNumber = GPIO_PIN_NO_0;
		SWITCH.gpio_config.gpio_PinMode  = GPIO_MODE_IN;
		SWITCH.gpio_config.gpio_PinPupdControl = GPIO_PU;
		GPIO_INIT(&SWITCH);

}



uint8_t SPI_VerifyResponse(uint8_t ackbyte)
{
	if(ackbyte == 0xF5)
	{
		// ack
		return 1;
	}
	else{
		return 0;
	}
}
int main(void)
{
	//char buff1[] = "Hello From STM32 We R Communicating via SPI\n";
	//char buff2[] = "Please Press Button To Initiate Transfer!!\n";
	uint8_t dummywrite = 0xff;
	uint8_t dummyread;
	uint8_t args[2];
	SPI2_GPIO_INIT();

    SPI2_INIT();

    SPI_SSI_Config(SPI2, DISABLE);

    // SSM 0 SSOE 1 this will set NSS to 0 so that Slave Nss is Grounded
    SPI_SSOE_Config(SPI2, ENABLE);
    Button_init();


    while (1)
    {
       if(!GPIO_Read_From_GPIOPIN(GPIOA, GPIO_PIN_NO_0))

    	{
            // debounce
            for(volatile int i=0;i<30000;i++);

           if(!GPIO_Read_From_GPIOPIN(GPIOA, GPIO_PIN_NO_0))

            {
        	   // enable the SPI2 periphral
                SPI_Peripheral_control(SPI2, ENABLE);

               // 1. CMD_LED_CTRL         pin num    val

                uint8_t CMD_CODE = CMD_LED_CTRL;
                //// Send Command Code (Indicates that the following data contains LED control instructions)

                SPI_SendData(SPI2,&CMD_CODE,1);

 // After sending CMD_CODE is pushed in Slave.A data is Popped from Slave side So we need something to store that Dummy data

                SPI_RecieveData(SPI2, &dummyread, 1);

//Send Dummy Byte(Generates Clock Pulses to Receive the Response) ESP32 holding 0xF5 it will be fetched by STM32 when dummy sent
                SPI_SendData(SPI2,&dummywrite,1);

//ESP32 Sends 0xF5 when dummy is recieved by Master(STM32) and stored in ackbyte
                uint8_t ackbyte;
                SPI_RecieveData(SPI2, &ackbyte, 1);

//if ackbyte is correct,args is stored with LED_PIN,SET data and sent to ESP32 and Recives the dummy data of 2 bytes in dummy_rx[]

                if(SPI_VerifyResponse(ackbyte)){
                	// send Arguments
                	args[0] = LED_PIN;  // send LEDPIN first
                	args[1] = SET;
                	SPI_SendData(SPI2,args,2);

                	 // Consume RX bytes generated by those 2 transmissions
                	    uint8_t dummy_rx[2];
                	    SPI_RecieveData(SPI2, dummy_rx, 2);

                }
              // Wait till Transfer is Complete.

                while(SPI_Get_Flag_status(SPI2, SPI_BUSY_FLAG));

             // Turn Off Communication , Disable SPI Comm

                SPI_Peripheral_control(SPI2, DISABLE);

                // test delay
               // for(volatile uint32_t i = 0; i < 100000; i++);

                // Wait until button released
                while(!GPIO_Read_From_GPIOPIN(GPIOA, GPIO_PIN_NO_0));
            }
        }
    }
	return 0;
}
